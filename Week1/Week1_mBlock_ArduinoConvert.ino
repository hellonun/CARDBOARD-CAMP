// generated by mBlock5 for <your product>
// codes make you happy

#include <Arduino.h>
#include <Wire.h>
#include <SoftwareSerial.h>

float brightness = 0;
float i = 0;
float j = 0;
float k = 0;
float state = 0;
float freq = 0;
float m = 0;
float buttonNow = 0;
float buttonLast = 0;
float buttonPressed = 0;

void _delay(float seconds) {
  long endTime = millis() + seconds * 1000;
  while(millis() < endTime) _loop();
}

void setup() {
  pinMode(2,OUTPUT);
  pinMode(3,OUTPUT);
  pinMode(4,OUTPUT);
  pinMode(5,OUTPUT);
  pinMode(12,INPUT_PULLUP);
  pinMode(11,INPUT_PULLUP);
  pinMode(10,INPUT_PULLUP);
  pinMode(9,INPUT_PULLUP);
  while(1) {
      if(!((digitalRead(12) == 1.000000))){
        digitalWrite(2,1);
        digitalWrite(3,0);
        digitalWrite(4,1);
        digitalWrite(5,0);

      }else{
        if(!((digitalRead(11) == 1.000000))){
          digitalWrite(2,0);
          digitalWrite(3,0);
          digitalWrite(4,0);
          digitalWrite(5,1);

        }else{
          if(!((digitalRead(10) == 1.000000))){
            digitalWrite(2,0);
            digitalWrite(3,1);
            digitalWrite(4,0);
            digitalWrite(5,1);

          }else{
            if(!((digitalRead(9) == 1.000000))){
              digitalWrite(2,0);
              digitalWrite(3,1);
              digitalWrite(4,0);
              digitalWrite(5,0);

            }else{
              digitalWrite(2,0);
              digitalWrite(3,0);
              digitalWrite(4,0);
              digitalWrite(5,0);

            }

          }

        }

      }
      delay(100);

      _loop();
  }

}

void _loop() {
}

void loop() {
  _loop();
}